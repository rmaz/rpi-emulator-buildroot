## package/gpsp/Config.in
```kconfig
config BR2_PACKAGE_GPSP
	depends on BR2_PACKAGE_SDL
        bool "gpsp"
        help
          A Gameboy Advance emulator.

comment "gpsp depends on SDL"
	depends on !BR2_PACKAGE_SDL
```
